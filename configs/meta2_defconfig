## configs/meta2_defconfig
```kconfig
BR2_metag=y
BR2_metag_2_1=y
BR2_WGET="wget --passive-ftp -nd"
BR2_DL_DIR=""
BR2_DEPRECATED=y
BR2_USE_UCLIBC_SNAPSHOT="20131204"
BR2_UCLIBC_CONFIG="target/metag/uClibc-0.9.33.config"
BR2_TOOLCHAIN_BUILDROOT_LARGEFILE=y
BR2_TOOLCHAIN_BUILDROOT_INET_IPV6=y
BR2_TOOLCHAIN_BUILDROOT_INET_RPC=y
BR2_TOOLCHAIN_BUILDROOT_WCHAR=y
BR2_EXTRA_GCC_CONFIG_OPTIONS="--with-cpu=2.1 --enable-meta-default --disable-symvers"
BR2_ENABLE_LOCALE_PURGE=y
BR2_ENABLE_LOCALE_WHITELIST="C en_US"
BR2_TARGET_OPTIMIZATION="-Os -pipe"
BR2_TARGET_GENERIC_GETTY_PORT="ttyDA2"
BR2_PACKAGE_BUSYBOX_SHOW_OTHERS=y
BR2_TARGET_ROOTFS_CPIO=y
# BR2_TARGET_ROOTFS_TAR is not set
```
